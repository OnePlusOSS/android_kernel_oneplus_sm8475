## drivers/misc/aw8680x/Kconfig
```kconfig
config AW8680X_SENSOR
	tristate "Awinic AW8680X Sensor driver"
	depends on I2C
	help
		Say Y here if you have Awinic aw8680x sensor controller
		chip in your system.
		If unsure, say N.
		To compile this driver as a module, choose M here: the
		module will be called aw8680x.
```

## drivers/uwb/Kconfig
```kconfig
#
# UWB device configuration
#

config UWB_NXP_SR100
        tristate "Nxp Sr100 Uwb protocol driver (SPI) devices"
        help
          This enables the SPI driver for SR100 based devices.

          If unsure, say N.

          This selects UWB SPI support.
```
